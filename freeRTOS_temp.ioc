# file: freeRTOS_temp.ioc
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FREERTOS.BinarySemaphores01=myBinarySem01,Dynamic,NULL
FREERTOS.Queues01=myQueue01,5,uint8_t,0,Dynamic,NULL,NULL
FREERTOS.Tasks01=task1,40,128,vTaskOne,Default,NULL,Dynamic,NULL,NULL;task2,24,128,vTaskTwo,Default,NULL,Dynamic,NULL,NULL
Mcu.Family=STM32F1
Mcu.Name=STM32F103C(8-B)Tx
Mcu.Package=LQFP48
NVIC.PriorityGroup=NVIC_PRIORITYGROUP_4
PD0-OSC_IN.Mode=HSE-External-Oscillator
PD0-OSC_IN.Signal=RCC_OSC_IN
PD1-OSC_OUT.Mode=HSE-External-Oscillator
PD1-OSC_OUT.Signal=RCC_OSC_OUT
ProjectManager.HeapSize=0x200
ProjectManager.StackSize=0x400
ProjectManager.TargetToolchain=STM32CubeIDE
RCC.AHBCLKDivider=RCC_SYSCLK_DIV2
RCC.AHBFreq_Value=8000000
RCC.APB1CLKDivider=RCC_HCLK_DIV4
RCC.APB1Freq_Value=2000000
RCC.APB1TimFreq_Value=4000000
RCC.APB2Freq_Value=8000000
RCC.APB2TimFreq_Value=8000000
RCC.HCLKFreq_Value=8000000
RCC.PLLSourceVirtual=RCC_PLLSOURCE_HSE
RCC.SYSCLKFreq_VALUE=16000000
RCC.SYSCLKSource=RCC_SYSCLKSOURCE_PLLCLK
RCC.USBFreq_Value=16000000
VP_FREERTOS_VS_CMSIS_V2.Mode=CMSIS_V2
board=custom

// file: Core/Src/main.c
/* USER CODE BEGIN Header */
/**
  ******************************************************************************
  * @file           : main.c
  * @brief          : Main program body
  ******************************************************************************
  * @attention
  *
  * Copyright (c) 2023 STMicroelectronics.
  * All rights reserved.
  *
  * This software is licensed under terms that can be found in the LICENSE file
  * in the root directory of this software component.
  * If no LICENSE file comes with this software, it is provided AS-IS.
  *
  ******************************************************************************
  */
/* USER CODE END Header */
#include "main.h"
#include "cmsis_os.h"
#include "gpio.h"

/* USER CODE BEGIN Includes */

#include "LED_interface.h"

/* USER CODE END Includes */

/* USER CODE BEGIN PV */

GPIO_ConfigType DecrementButton = {.GPIOx=GPIOA, .GPIO_PinNumber=GPIO_PIN_8  , .GPIO_PinMode=GPIO_IN};
GPIO_ConfigType ChoiceButton = {.GPIOx=GPIOB, .GPIO_PinNumber=GPIO_PIN_3 , .GPIO_PinMode=GPIO_IN};
GPIO_ConfigType IncrementButton = {.GPIOx=GPIOB, .GPIO_PinNumber=GPIO_PIN_9 , .GPIO_PinMode=GPIO_IN};

/* USER CODE END PV */

void SystemClock_Config(void);
void MX_FREERTOS_Init(void);

int main(void)
{

  /* MCU Configuration--------------------------------------------------------*/

  /* Reset of all peripherals, Initializes the Flash interface and the Systick. */
  HAL_Init();

  /* USER CODE BEGIN Init */

	MRCC_voidClockInit(&RCC_obj);
	MRCC_voidPeripheralClockEnable(RCC_APB2_BUS , RCC_GPIOA_CLOCK);
	MRCC_voidPeripheralClockEnable(RCC_APB2_BUS , RCC_GPIOB_CLOCK);

	lcd_4bit_intialize(&lcd_1);
	MGPIO_voidInitPortPin(&DecrementButton);
	MGPIO_voidInitPortPin(&ChoiceButton);
	MGPIO_voidInitPortPin(&IncrementButton);

  /* USER CODE END Init */

  /* Configure the system clock */
  SystemClock_Config();

  /* Initialize all configured peripherals */
  MX_GPIO_Init();

  /* Init scheduler */
  osKernelInitialize();  /* Call init function for freertos objects (in freertos.c) */
  MX_FREERTOS_Init();

  /* Start scheduler */
  osKernelStart();

  /* We should never get here as control is now taken by the scheduler */
  /* Infinite loop */
  while (1)
  {

  }
}

void SystemClock_Config(void)
{
  RCC_OscInitTypeDef RCC_OscInitStruct = {0};
  RCC_ClkInitTypeDef RCC_ClkInitStruct = {0};

  /** Initializes the RCC Oscillators according to the specified parameters
  * in the RCC_OscInitTypeDef structure.
  */
  RCC_OscInitStruct.OscillatorType = RCC_OSCILLATORTYPE_HSE;
  RCC_OscInitStruct.HSEState = RCC_HSE_ON;
  RCC_OscInitStruct.HSEPredivValue = RCC_HSE_PREDIV_DIV1;
  RCC_OscInitStruct.HSIState = RCC_HSI_ON;
  RCC_OscInitStruct.PLL.PLLState = RCC_PLL_ON;
  RCC_OscInitStruct.PLL.PLLSource = RCC_PLLSOURCE_HSE;
  RCC_OscInitStruct.PLL.PLLMUL = RCC_PLL_MUL2;
  if (HAL_RCC_OscConfig(&RCC_OscInitStruct) != HAL_OK)
  {
    Error_Handler();
  }

  /** Initializes the CPU, AHB and APB buses clocks
  */
  RCC_ClkInitStruct.ClockType = RCC_CLOCKTYPE_HCLK|RCC_CLOCKTYPE_SYSCLK
                              |RCC_CLOCKTYPE_PCLK1|RCC_CLOCKTYPE_PCLK2;
  RCC_ClkInitStruct.SYSCLKSource = RCC_SYSCLKSOURCE_PLLCLK;
  RCC_ClkInitStruct.AHBCLKDivider = RCC_SYSCLK_DIV2;
  RCC_ClkInitStruct.APB1CLKDivider = RCC_HCLK_DIV4;
  RCC_ClkInitStruct.APB2CLKDivider = RCC_HCLK_DIV1;

  if (HAL_RCC_ClockConfig(&RCC_ClkInitStruct, FLASH_LATENCY_0) != HAL_OK)
  {
    Error_Handler();
  }
}

void Error_Handler(void)
{
  __disable_irq();
  while (1)
  {
  }
}

// file: Core/Src/freertos.c
e/* USER CODE BEGIN Header */
/**
  ******************************************************************************
  * File Name          : freertos.c
  * Description        : Code for freertos applications
  ******************************************************************************
  * @attention
  *
  * Copyright (c) 2023 STMicroelectronics.
  * All rights reserved.
  *
  * This software is licensed under terms that can be found in the LICENSE file
  * in the root directory of this software component.
  * If no LICENSE file comes with this software, it is provided AS-IS.
  *
  ******************************************************************************
  */
/* USER CODE END Header */

#include "FreeRTOS.h"
#include "task.h"
#include "main.h"
#include "cmsis_os.h"

/* USER CODE BEGIN Includes */

#include "LCD_interface.h"
#include "queue.h"

/* USER CODE END Includes */

/* USER CODE BEGIN PD */

#define STAGE_ONE	1
#define STAGE_TWO	2

#define FIRST_FRAME         	1
#define SECOND_FRAME         	2
#define THIRD_FRAME       		3
#define FOURTH_FRAME        	4
#define FIFTH_FRAME        		5

/* USER CODE END PD */

/* USER CODE BEGIN Variables */

extern GPIO_ConfigType DecrementButton;
extern GPIO_ConfigType ChoiceButton;
extern GPIO_ConfigType IncrementButton;

uint8_t CurrentFrame = FIRST_FRAME;

uint8_t *FirstScreenFrames[6][2] =
{
		{"**  Mood One  **",	"*  Temprature  *"},
		{"**  Mood Two  **",	"* AirCondition *"},
		{"*  Mood Three  *",	"**  Pressure  **"},
		{"*  Mood  Four  *",	"**  Humadity  **"},
		{"*  Mood  Five  *",	"* GasDetection *"}
};

uint8_t *ScoundScreenFrames[6][2] =
{
		{"Temperature Mode",	"Temperature => *"},
		{"AirConditionMode",	"AirCondition=>**"},
		{" Pressure  Mode ",	"Pressure => ****"},
		{"* HumadityMood *",	"Humadity => ****"},
		{"**  Gas Mood  **",	"GasDetecte => *"}
};

/* USER CODE END Variables */
/* Definitions for task1 */
osThreadId_t task1Handle;
const osThreadAttr_t task1_attributes = {
  .name = "task1",
  .stack_size = 128 * 4,
  .priority = (osPriority_t) osPriorityHigh,
};
/* Definitions for task2 */
osThreadId_t task2Handle;
const osThreadAttr_t task2_attributes = {
  .name = "task2",
  .stack_size = 128 * 4,
  .priority = (osPriority_t) osPriorityAboveNormal1,
};
/* Definitions for myQueue01 */
osMessageQueueId_t myQueue01Handle;
const osMessageQueueAttr_t myQueue01_attributes = {
  .name = "myQueue01"
};
/* Definitions for myBinarySem01 */
osSemaphoreId_t myBinarySem01Handle;
const osSemaphoreAttr_t myBinarySem01_attributes = {
  .name = "myBinarySem01"
};

/* USER CODE BEGIN FunctionPrototypes */

void LcdSetFrame(uint8_t stage, uint8_t frame);

/* USER CODE END FunctionPrototypes */

void vTaskOne(void *argument);
void vTaskTwo(void *argument);

void MX_FREERTOS_Init(void); /* (MISRA C 2004 rule 8.1) */

void MX_FREERTOS_Init(void) {

  /* Create the semaphores(s) */
  /* creation of myBinarySem01 */
  myBinarySem01Handle = osSemaphoreNew(1, 0, &myBinarySem01_attributes);

  /* Create the queue(s) */
  /* creation of myQueue01 */
  myQueue01Handle = osMessageQueueNew (6, sizeof(uint8_t), &myQueue01_attributes);

  /* Create the thread(s) */
  /* creation of task1 */
  task1Handle = osThreadNew(vTaskOne, NULL, &task1_attributes);

  /* creation of task2 */
  task2Handle = osThreadNew(vTaskTwo, NULL, &task2_attributes);

}

void vTaskOne(void *argument)
{
  /* USER CODE BEGIN vTaskOne */

	BaseType_t RetVal = pdTRUE; //has the status of sending message
	uint8_t IncrementButtonState = 0; //has the status of the increment Button
	uint8_t DecrementButtonState = 0; //has the status of the decrement Button
	uint8_t ChoiceButtonState = 0;								 //has the status if context to secound task or no

  /* Infinite loop */
	for(;;)
	{
		LcdSetFrame(STAGE_ONE, CurrentFrame);

		ChoiceButtonState = MGPIO_u8ReadPortPin(&ChoiceButton);
		IncrementButtonState = MGPIO_u8ReadPortPin(&IncrementButton);
		DecrementButtonState = MGPIO_u8ReadPortPin(&DecrementButton);

		if(GPIO_HIGH == IncrementButtonState)
		{
			if(CurrentFrame == FIFTH_FRAME) CurrentFrame = FIRST_FRAME;
			else CurrentFrame++;
		}
		if(GPIO_HIGH == DecrementButtonState)
		{
			if(CurrentFrame == FIRST_FRAME) CurrentFrame = FIFTH_FRAME;
			else CurrentFrame-- ;
		}
		if(GPIO_HIGH == ChoiceButtonState)
		{
			RetVal = xQueueSendToFront(myQueue01Handle, (void *)&CurrentFrame, HAL_MAX_DELAY);
			osSemaphoreAcquire(myBinarySem01Handle, HAL_MAX_DELAY);
		}
		HAL_Delay(10);
	}
  /* USER CODE END vTaskOne */
}

void vTaskTwo(void *argument)
{
  /* USER CODE BEGIN vTaskTwo */

	BaseType_t RetVal = pdTRUE;
	uint8_t message = 0;
	uint8_t choice = 0;

  /* Infinite loop */
	for(;;)
	{
		RetVal= xQueueReceive(myQueue01Handle, &message, HAL_MAX_DELAY);
		if(pdTRUE == RetVal)
			LcdSetFrame(STAGE_TWO, message);

		choice = MGPIO_u8ReadPortPin(&ChoiceButton);
		HAL_Delay(100);

		if(GPIO_HIGH == choice)
			osSemaphoreRelease(myBinarySem01Handle);

		else RetVal = xQueueSendToFront(myQueue01Handle, (void *)&message, HAL_MAX_DELAY);
	}
  /* USER CODE END vTaskTwo */
}

/* USER CODE BEGIN Application */

void LcdSetFrame(uint8_t stage, uint8_t frame)
{
	frame--;
	switch(stage)
	{
		case STAGE_ONE :
			lcd_4bit_send_string_pos(&lcd_1, 1, 1, FirstScreenFrames[frame][0]);
			lcd_4bit_send_string_pos(&lcd_1, 2, 1, FirstScreenFrames[frame][1]);
			break;

		case STAGE_TWO :
			lcd_4bit_send_string_pos(&lcd_1, 1, 1, ScoundScreenFrames[frame][0]);
			lcd_4bit_send_string_pos(&lcd_1, 2, 1, ScoundScreenFrames[frame][1]);
			break;
	}
}

/* Task to be created. */

/* USER CODE END Application */
